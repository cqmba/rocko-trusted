## build/conf/bblayers.conf
```bitbake
# POKY_BBLAYERS_CONF_VERSION is increased each time build/conf/bblayers.conf
# changes incompatibly
POKY_BBLAYERS_CONF_VERSION = "2"

BBPATH = "${TOPDIR}"
BBFILES ?= ""

BBLAYERS ?= " \
  /home/markus/rocko/poky/meta \
  /home/markus/rocko/poky/meta-poky \
  /home/markus/rocko/poky/meta-yocto-bsp \
  /home/markus/rocko/meta-openembedded/meta-oe \
  /home/markus/rocko/meta-openembedded/meta-multimedia \
  /home/markus/rocko/meta-openembedded/meta-python \
  /home/markus/rocko/meta-openembedded/meta-networking \
  /home/markus/rocko/meta-raspberrypi \
  /home/markus/rocko/meta-intel-iot-security/meta-security-framework \
  /home/markus/rocko/meta-intel-iot-security/meta-integrity \
  /home/markus/rocko/meta-tpmenable \
  "
```

## meta-tpmenable/conf/layer.conf
```bitbake
# We have a conf and classes directory, add to BBPATH
BBPATH .= ":${LAYERDIR}"

# We have recipes-* directories, add to BBFILES
BBFILES += "${LAYERDIR}/recipes-*/*/*.bb \
            ${LAYERDIR}/recipes-*/*/*.bbappend"

BBFILE_COLLECTIONS += "meta-tpmenable"
BBFILE_PATTERN_meta-tpmenable = "^${LAYERDIR}/"
BBFILE_PRIORITY_meta-tpmenable = "6"

LAYERDEPENDS_meta-tpmenable = "core"
LAYERSERIES_COMPAT_meta-tpmenable = "rocko sumo thud"
```
